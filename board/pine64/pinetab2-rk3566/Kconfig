## board/pine64/pinetab2-rk3566/Kconfig
```kconfig
if TARGET_PINETAB2_RK3566

config SYS_BOARD
	default "pinetab2-rk3566"

config SYS_VENDOR
	default "pine64"

config SYS_CONFIG_NAME
	default "pinetab2-rk3566"

config BOARD_SPECIFIC_OPTIONS
	def_bool y

endif
```
